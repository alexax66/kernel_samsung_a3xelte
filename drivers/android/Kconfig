## drivers/android/Kconfig
```kconfig
menu "Android"

config ANDROID
	bool "Android Drivers"
	---help---
	  Enable support for various drivers needed on the Android platform

if ANDROID

config ANDROID_BINDER_IPC
	bool "Android Binder IPC Driver"
	default n
	---help---
	  Binder is used in Android for both communication between processes,
	  and remote method invocation.

	  This means one Android process can call a method/routine in another
	  Android process, using Binder to identify, invoke and pass arguments
	  between said processes.

config ANDROID_BINDER_DEVICES
	string "Android Binder devices"
	depends on ANDROID_BINDER_IPC
	default "binder"
	---help---
	  Default value for the binder.devices parameter.

	  The binder.devices parameter is a comma-separated list of strings
	  that specifies the names of the binder device nodes that will be
	  created. Each binder device has its own context manager, and is
	  therefore logically separated from the other devices.

config ANDROID_BINDER_IPC_32BIT
	bool "Use old 32-bit binder api"
        default y
	---help---
	  Enable to support an old 32-bit Android user-space. Breaks the new
	  Android user-space.

endif # if ANDROID

endmenu
```

## drivers/staging/zcache/Kconfig
```kconfig
config ZCACHE
	tristate "Dynamic compression of swap pages and clean pagecache pages"
	depends on (CLEANCACHE || FRONTSWAP) && CRYPTO=y
	select ZSMALLOC
	select CRYPTO_LZO
	select LZO_COMPRESS
	select LZO_DECOMPRESS
	default n
	help
	  Zcache doubles RAM efficiency while providing a significant
	  performance boosts on many workloads.  Zcache uses lzo1x or lz4
	  compression and an in-kernel implementation of transcendent
	  memory to store clean page cache pages and swap in RAM,
	  providing a noticeable reduction in disk I/O.

config ZCACHE_LZ4_COMPRESS
	bool "Enable LZ4 algorithm support"
	depends on ZCACHE
	select CRYPTO_LZ4
	select LZ4_COMPRESS
	select LZ4_DECOMPRESS
	default n
	help
	  This option enables LZ4 compression algorithm support.
```
